#include <dt-bindings/zmk/matrix-transform.h>

&{/} {
    matrix_transform: matrix_transform {
        compatible = "zmk,matrix-transform";
        rows = <8>;
        cols = <16>;

        row-map = < 0 1 2 3 4 5 6 7 >;
        col-map = < 0 1 2 3 4 5 6 7 8 9 10 11 12 13 14 15 >;
    };
};
