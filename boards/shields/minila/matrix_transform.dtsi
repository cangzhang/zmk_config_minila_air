/ {
    transform: matrix_transform {
        compatible = "zmk,matrix-transform";
        rows       = <8>;
        columns    = <16>;

        map = <
            0   1   2   3   4   5   6   7   8   9   10  11  -1  -1  -1  -1
            16  17  18  19  -1  21  22  23  24  25  26  -1  28  -1  -1  -1
            32  33  34  35  -1  37  38  39  40  41  -1  43  -1  45  -1  -1
            48  49  -1  -1  -1  53  -1  -1  -1  -1  58  -1  -1  -1  -1  -1
            64  65  66  67  -1  69  70  71  -1  73  -1  75  -1  -1  -1  -1
            -1  -1  -1  -1  -1  85  -1  -1  -1  89  -1  91  92  93  94  95
            96  97  -1  -1  -1  -1 102 103  -1  -1 106  -1  -1  -1  -1  -1
            112 113 114 115  -1  -1  -1  -1  -1  -1  -1  -1  -1  -1  -1  -1
        >;
    };
};